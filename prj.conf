## CMakeLists.txt
```
# SPDX-License-Identifier: Apache-2.0

cmake_minimum_required(VERSION 3.20.0)

find_package(Zephyr REQUIRED HINTS $ENV{ZEPHYR_BASE})
project(hello_world)

target_sources(app PRIVATE src/main.c)

# CAF modules

# Add include directory for board specific CAF def files
zephyr_include_directories(
  configuration/${BOARD}
  configuration/default
  )

target_sources(app PRIVATE src/modules/module_test_1.c)
```

## prj.conf
```kconfig
# Debug
CONFIG_DEBUG_THREAD_INFO=y
CONFIG_DEBUG_OPTIMIZATIONS=y

# System
CONFIG_LOG=y
CONFIG_HWINFO=y
CONFIG_HEAP_MEM_POOL_SIZE=4096

# Settings
CONFIG_FLASH=y
CONFIG_NVS=y
CONFIG_FLASH_MAP=y
CONFIG_SETTINGS=y
CONFIG_SETTINGS_SHELL=y

# CAF
CONFIG_CAF=y

# SHELL
CONFIG_SHELL=y
```

## src/main.c
```c
/*
 * Copyright (c) 2022 Addiva Elektronik AB
 *
 * SPDX-License-Identifier: Apache-2.0
 */

#define MODULE main

#include <zephyr/zephyr.h>
#include <app_event_manager.h>
#include <caf/events/module_state_event.h>
#include <zephyr/logging/log.h>
#include <zephyr/drivers/hwinfo.h>
#include <zephyr/settings/settings.h>
#include <zephyr/shell/shell.h>

LOG_MODULE_REGISTER(MODULE);

uint8_t device_id[8];

void main(void)
{
	LOG_INF("Starting");

	// Prepare whats needed before application starts
	hwinfo_get_device_id(device_id, sizeof(device_id));
	LOG_HEXDUMP_INF(device_id, sizeof(device_id), "Device ID");

	// Initialize system services, storage, settings etc.
	settings_subsys_init();
	settings_load();

	// Start CAF and signal that main have completed the system setup
	if (app_event_manager_init()) {
		LOG_ERR("Application Event Manager not initialized");
	} else {
		module_set_state(MODULE_STATE_READY);
	}

	LOG_INF("Done");
}

// settings shell is missing a reload command to load new settings
// after written
static int cmd_reload(const struct shell *shell, size_t argc,
                         char **argv)
{
	LOG_INF("Reloading settings");
	settings_load();
}

SHELL_CMD_REGISTER(reload, NULL, "Reload settings", cmd_reload);
```
